## meta-lmp-extension/conf/layer.conf
```bitbake
# We have a conf and classes directory, add to BBPATH
BBPATH .= ":${LAYERDIR}"

# We have recipes-* directories, add to BBFILES
BBFILES += "${LAYERDIR}/recipes-*/*/*.bb \
            ${LAYERDIR}/recipes-*/*/*.bbappend"

BBFILE_COLLECTIONS += "meta-lmp-extension"
BBFILE_PATTERN_meta-lmp-extension = "^${LAYERDIR}/"
BBFILE_PRIORITY_meta-lmp-extension = "10"

LAYERDEPENDS_meta-lmp-extension = "core"
LAYERSERIES_COMPAT_meta-lmp-extension = "kirkstone"
```

## meta-secure-platform-bsp/conf/layer.conf
```bitbake
# We have a conf and classes directory, add to BBPATH
BBPATH .= ":${LAYERDIR}"

# We have recipes-* directories, add to BBFILES
BBFILES += "${LAYERDIR}/recipes-*/*/*.bb \
            ${LAYERDIR}/recipes-*/*/*.bbappend"

BBFILE_COLLECTIONS += "meta-secure-platform-bsp"
BBFILE_PATTERN_meta-secure-platform-bsp = "^${LAYERDIR}/"
BBFILE_PRIORITY_meta-secure-platform-bsp = "11"

LAYERDEPENDS_meta-secure-platform-bsp = "core"
LAYERSERIES_COMPAT_meta-secure-platform-bsp = "kirkstone langdale"


BBFILES_DYNAMIC += " \
    freescale-layer:${LAYERDIR}/dynamic-layers/freescale-layer/*/*/*.bb \
    freescale-layer:${LAYERDIR}/dynamic-layers/freescale-layer/*/*/*.bbappend \
"
```

## meta-secure-platform-bsp/conf/machine/qemuarm64-sec.conf
```bitbake
MACHINEOVERRIDES =. "qemuarm64:qemuall:"

require ${COREBASE}/meta/conf/machine/qemuarm64.conf
require secure-platform-common.inc

KMACHINE = "qemuarm64"
UBOOT_ENTRYPOINT = "0x44000000"
PREFERRED_PROVIDER_u-boot-default-script:qemuarm64 = "u-boot-base-scr"
WKS_FILE_DEPENDS:append = " u-boot-default-script"
WKS_FILE = "ab-boot-image-disk.wks"
IMAGE_BOOT_FILES = "boot.scr boot_dualboot.scr"
THISTLE_BOOT_PART_A = "/dev/sda2"
THISTLE_BOOT_PART_B = "/dev/sda3"
```

## meta-secure-platform-bsp/wic/ab-boot-image-disk.wks
```
# short-description: Create an A/B partition disk image

part /mnt/boot --source bootimg-partition --ondisk sda --fstype=vfat --label boot --active --align 4096 --size 20
part / --source rootfs --label rootfs_a --ondisk sda --fstype=ext4 --align 4096
part --source rootfs --label rootfs_b --ondisk sda --fstype=ext4 --align 4096
part /mnt/persist --label persist --ondisk sda --fstype=ext4 --align 4096 --size 128M
```

## meta-secure-platform-bsp/wic/ab-boot-image-sd.wks
```
# short-description: Create an A/B partition SD card image

part /mnt/boot --source bootimg-partition --ondisk mmcblk0 --fstype=vfat --label boot --active --align 4096 --size 20
part / --source rootfs --label rootfs_a --ondisk mmcblk0 --fstype=ext4 --align 4096
part --source rootfs --label rootfs_b --ondisk mmcblk0 --fstype=ext4 --align 4096
part /mnt/persist --label persist --ondisk mmcblk0 --fstype=ext4 --align 4096 --size 100
```

## meta-secure-platform/conf/distro/tsp-base.conf
```bitbake
DISTRO = "tsp-base"
DISTRO_NAME = "Thistle Secure Platform"
DISTRO_VERSION = "0.1.0"
IMAGE_LINGUAS ?= "en-us"
MAINTAINER = "Thistle Support <support@thistle.tech>"
SDK_VENDOR = "-tspsdk"
SDK_VERSION = "${@d.getVar('DISTRO_VERSION').replace('snapshot-${METADATA_REVISION}', 'snapshot')}"
SDK_VERSION[vardepvalue] = "${SDK_VERSION}"
TARGET_VENDOR = "-tsp"
LOCALCONF_VERSION = "2"

DISTRO_FEATURES_DEFAULT = "acl argp ext2 ipv4 ipv6 largefile usbgadget usbhost wifi xattr pci vfat security integrity"
DISTRO_FEATURES:append = " pam usrmerge virtualization"

VIRTUAL-RUNTIME_init_manager = "systemd"
DISTRO_FEATURES_BACKFILL_CONSIDERED = "sysvinit"
VIRTUAL-RUNTIME_base-utils-syslog = ""



SDK_NAME = "${DISTRO}-${TCLIBC}-${SDKMACHINE}-${IMAGE_BASENAME}-${TUNE_PKGARCH}-${MACHINE}"
SDKPATHINSTALL = "/opt/${DISTRO}/${SDK_VERSION}"

# Remove the "-${libc}" from the tmp directory
TCLIBCAPPEND = ""

require conf/distro/include/security_flags.inc
require conf/distro/include/no-static-libs.inc
require conf/distro/include/yocto-uninative.inc
INHERIT += "uninative"

BB_SIGNATURE_HANDLER ?= "OEEquivHash"
BB_HASHSERVE ??= "auto"

PREFERRED_PROVIDER_virtual/optee-os ?= "optee-os-fio"
PREFERRED_PROVIDER_virtual/kernel ?= "linux-fslc-imx"
PREFERRED_PROVIDER_u-boot-fw-utils ?= "libubootenv"
PREFERRED_RPROVIDER_u-boot-fw-utils ?= "libubootenv"
PREFERRED_PROVIDER_zlib ?= "zlib"
PREFERRED_PROVIDER_zlib-native ?= "zlib-native"
PREFERRED_PROVIDER_nativesdk-zlib ?= "nativesdk-zlib"
PREFERRED_PROVIDER_qemu-native ?= "qemu-native"
PREFERRED_PROVIDER_qemu-helper-native ?= "qemu-helper-native"
PREFERRED_PROVIDER_nativesdk-qemu ?= "nativesdk-qemu"

PREFERRED_VERSION_linux-yocto ?= "5.15%"
PREFERRED_VERSION_linux-yocto-rt ?= "5.15%"
PREFERRED_VERSION_gcc-arm-none-eabi ?= "10.3-2021.10"
PREFERRED_VERSION_gcc-arm-none-eabi-native ?= "10.3-2021.10"

# Default distro features for LMP (can be extended by the user if needed)
INIT_MANAGER = "systemd"

# Default IMA policy (tcb)
IMA_POLICY ?= "ima-policy-tcb"

PACKAGECONFIG:append:pn-qemu-native = " libusb"
PACKAGECONFIG:append:pn-networkmanager = " libedit"
PACKAGECONFIG:remove:pn-networkmanager = " readline"
PACKAGECONFIG:append:pn-kmod = " openssl"
PACKAGECONFIG:append:pn-kmod-native = " openssl"
PACKAGECONFIG:append:pn-cryptsetup = " luks2"
PACKAGECONFIG:append:pn-cryptsetup-native = " luks2"

# Default image formats
IMAGE_FSTYPES = "wic wic.gz wic.bmap ext4"
IMAGE_FSTYPES:remove = "tar.gz tar.bz2"

KERNEL_CLASSES  = " kernel-fitimage "
KERNEL_IMAGETYPES = "fitImage"

# QA check settings - follow poky, which is stricter than the OE-Core defaults
WARN_TO_ERROR_QA = "already-stripped compile-host-path install-host-path \
                    installed-vs-shipped ldflags pn-overrides rpaths staticdev \
                    unknown-configure-option useless-rpaths"
WARN_QA:remove = "${WARN_TO_ERROR_QA}"
ERROR_QA:append = " ${WARN_TO_ERROR_QA}"
ERROR_QA:remove = "version-going-backwards"

# Required to avoid removing libraries used during signing
RM_WORK_EXCLUDE += "make-mod-scripts"
```

## meta-secure-platform/conf/layer.conf
```bitbake
# We have a conf and classes directory, add to BBPATH
BBPATH .= ":${LAYERDIR}"

# We have recipes-* directories, add to BBFILES
BBFILES += "${LAYERDIR}/recipes-*/*/*.bb \
            ${LAYERDIR}/recipes-*/*/*.bbappend"

BBFILE_COLLECTIONS += "meta-secure-platform"
BBFILE_PATTERN_meta-secure-platform = "^${LAYERDIR}/"
BBFILE_PRIORITY_meta-secure-platform = "11"

LAYERDEPENDS_meta-secure-platform = "core"
LAYERSERIES_COMPAT_meta-secure-platform = "kirkstone langdale"
```

## meta-thistle-base-bsp/conf/layer.conf
```bitbake
# We have a conf and classes directory, add to BBPATH
BBPATH .= ":${LAYERDIR}"

# We have recipes-* directories, add to BBFILES
BBFILES += "${LAYERDIR}/recipes-*/*/*.bb \
            ${LAYERDIR}/recipes-*/*/*.bbappend"

BBFILE_COLLECTIONS += "meta-thistle-base-bsp"
BBFILE_PATTERN_meta-thistle-base-bsp = "^${LAYERDIR}/"
BBFILE_PRIORITY_meta-thistle-base-bsp = "11"

LAYERDEPENDS_meta-thistle-base-bsp = "core"
LAYERSERIES_COMPAT_meta-thistle-base-bsp = "kirkstone langdale"
```

## meta-thistle-base-bsp/conf/machine/qemuarm64-thistle.conf
```bitbake
# amend qemuarm64 image to add features and enable uboot

MACHINEOVERRIDES =. "qemuarm64:qemuall:"

require ${COREBASE}/meta/conf/machine/qemuarm64.conf
require secure-platform-common.inc

KMACHINE = "qemuarm64"
WKS_FILE = "ab-boot-image-disk.wks"

# uboot specific
UBOOT_ENTRYPOINT = "0x44000000"
PREFERRED_PROVIDER_u-boot-default-script:qemuarm64 = "u-boot-base-scr"
WKS_FILE_DEPENDS:append = " u-boot-default-script"
IMAGE_BOOT_FILES = "boot.scr boot_dualboot.scr"
```

## meta-thistle-base-bsp/conf/machine/raspberrypi0-thistle.conf
```bitbake
#@TYPE: Machine
#@NAME: RaspberryPi 0 Development Board

MACHINEOVERRIDES =. "raspberrypi0"

require conf/machine/raspberrypi0.conf
require secure-platform-common.inc

WKS_FILE = "ab-boot-image-sd.wks"
ENABLE_UART = "1"
SERIAL_CONSOLES = ""
IMAGE_FSTYPES:append = " ext4"
```

## meta-thistle-base-bsp/conf/machine/raspberrypi4-64-thistle.conf
```bitbake
#@TYPE: Machine
#@NAME: RaspberryPi 4 Development Board (64bit)
#@DESCRIPTION: amend qemuarm64 image to add features and enable uboot

MACHINEOVERRIDES =. "raspberrypi4-64"

require conf/machine/raspberrypi4-64.conf

## uboot
# PREFERRED_PROVIDER_u-boot-default-script:rpi = "u-boot-base-scr"
# WKS_FILE_DEPENDS:append = " u-boot-default-script"
# IMAGE_BOOT_FILES:append:rpi = "boot.scr boot_dualboot.scr"
# RPI_USE_U_BOOT = "1"

WKS_FILE = "ab-boot-image-sd.wks"
ENABLE_UART = "1"
SERIAL_CONSOLES = ""
IMAGE_FSTYPES:append = " ext4"
```

## meta-thistle-base-bsp/conf/machine/secure-platform-common.inc
```bitbake
fakeroot create_mount_dirs () {
   mkdir -p ${IMAGE_ROOTFS}/mnt/boot
}

IMAGE_PREPROCESS_COMMAND += "create_mount_dirs;"
```

## meta-thistle-base-bsp/wic/ab-boot-image-sd.wks
```
# short-description: Create an A/B partition SD card image

part /boot --source bootimg-partition --ondisk mmcblk0 --fstype=vfat --label boot --active --align 4096 --size 20
part / --source rootfs --label rootfs_a --ondisk mmcblk0 --fstype=ext4 --align 4096
part --source rootfs --label rootfs_b --ondisk mmcblk0 --fstype=ext4 --align 4096
```

## meta-thistle-base/conf/layer.conf
```bitbake
# We have a conf and classes directory, add to BBPATH
BBPATH .= ":${LAYERDIR}"

# We have recipes-* directories, add to BBFILES
BBFILES += "${LAYERDIR}/recipes-*/*/*.bb \
            ${LAYERDIR}/recipes-*/*/*.bbappend"

BBFILE_COLLECTIONS += "meta-thistle-base"
BBFILE_PATTERN_meta-thistle-base = "^${LAYERDIR}/"
BBFILE_PRIORITY_meta-thistle-base = "11"

LAYERDEPENDS_meta-thistle-base = "core"
LAYERSERIES_COMPAT_meta-thistle-base = "kirkstone langdale"
```

## meta-thistle-update-client/conf/layer.conf
```bitbake
# We have a conf and classes directory, add to BBPATH
BBPATH .= ":${LAYERDIR}"

# We have recipes-* directories, add to BBFILES
BBFILES += "${LAYERDIR}/recipes-*/*/*.bb \
            ${LAYERDIR}/recipes-*/*/*.bbappend"

BBFILE_COLLECTIONS += "meta-thistle-update-client"
BBFILE_PATTERN_meta-thistle-update-client = "^${LAYERDIR}/"
BBFILE_PRIORITY_meta-thistle-update-client = "6"

LAYERDEPENDS_meta-thistle-update-client = "core"
LAYERSERIES_COMPAT_meta-thistle-update-client = "kirkstone"
```

## meta-trust-m/conf/layer.conf
```bitbake
# We have a conf and classes directory, add to BBPATH
BBPATH .= ":${LAYERDIR}"

# We have recipes-* directories, add to BBFILES
BBFILES += "${LAYERDIR}/recipes-*/*/*.bb \
            ${LAYERDIR}/recipes-*/*/*.bbappend"

BBFILE_COLLECTIONS += "meta-trust-m"
BBFILE_PATTERN_meta-trust-m = "^${LAYERDIR}/"
BBFILE_PRIORITY_meta-trust-m = "6"

LAYERDEPENDS_meta-trust-m = "core"
LAYERSERIES_COMPAT_meta-trust-m = "kirkstone"
```

## meta-update-client/conf/layer.conf
```bitbake
# We have a conf and classes directory, add to BBPATH
BBPATH .= ":${LAYERDIR}"

# We have recipes-* directories, add to BBFILES
BBFILES += "${LAYERDIR}/recipes-*/*/*.bb \
            ${LAYERDIR}/recipes-*/*/*.bbappend"

BBFILE_COLLECTIONS += "meta-update-client"
BBFILE_PATTERN_meta-update-client = "^${LAYERDIR}/"
BBFILE_PRIORITY_meta-update-client = "6"

LAYERDEPENDS_meta-update-client = "core"
LAYERSERIES_COMPAT_meta-update-client = "kirkstone"
```
